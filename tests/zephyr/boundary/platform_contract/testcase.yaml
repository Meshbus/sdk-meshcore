## tests/zephyr/boundary/platform_contract/testcase.yaml
```yaml
# SPDX-FileCopyrightText: 2026 FoBE Studio
# SPDX-License-Identifier: Apache-2.0
tests:
  lib.meshcore.boundary.platform_contract:
    tags:
      - meshcore
      - boundary
      - platform
      - ztest
    harness: ztest
    platform_allow:
      - qemu_x86
      - native_sim
    integration_platforms:
      - native_sim
```

## tests/zephyr/boundary/public_contract/testcase.yaml
```yaml
# SPDX-FileCopyrightText: 2026 FoBE Studio
# SPDX-License-Identifier: Apache-2.0
tests:
  lib.meshcore.boundary.public_contract:
    tags:
      - meshcore
      - boundary
      - public_contract
      - ztest
    harness: ztest
    platform_allow:
      - qemu_x86
      - native_sim
    integration_platforms:
      - native_sim
```

## tests/zephyr/protocol/advert_data/testcase.yaml
```yaml
# SPDX-FileCopyrightText: 2026 FoBE Studio
# SPDX-License-Identifier: Apache-2.0
tests:
  lib.meshcore.advert_data.tdd:
    tags:
      - meshcore
      - advert_data
      - ztest
    harness: ztest
    platform_allow:
      - qemu_x86
      - native_sim
    integration_platforms:
      - native_sim
```

## tests/zephyr/protocol/cayenne_lpp_compat/testcase.yaml
```yaml
# SPDX-FileCopyrightText: 2026 FoBE Studio
# SPDX-License-Identifier: Apache-2.0
tests:
  lib.meshcore.cayenne_lpp_compat.tdd:
    tags:
      - meshcore
      - cayenne_lpp_compat
      - ztest
    harness: ztest
    platform_allow:
      - qemu_x86
      - native_sim
    integration_platforms:
      - native_sim
```

## tests/zephyr/protocol/clock/testcase.yaml
```yaml
# SPDX-FileCopyrightText: 2026 FoBE Studio
# SPDX-License-Identifier: Apache-2.0
tests:
  lib.meshcore.clock.tdd:
    tags:
      - meshcore
      - clock
      - ztest
    harness: ztest
    platform_allow:
      - qemu_x86
      - native_sim
    integration_platforms:
      - native_sim
```

## tests/zephyr/protocol/mesh/testcase.yaml
```yaml
# SPDX-FileCopyrightText: 2026 FoBE Studio
# SPDX-License-Identifier: Apache-2.0
tests:
  lib.meshcore.mesh.tdd:
    tags:
      - meshcore
      - mesh
      - ztest
    harness: ztest
    platform_allow:
      - qemu_x86
      - native_sim
    integration_platforms:
      - native_sim
```

## tests/zephyr/protocol/packet_manager/testcase.yaml
```yaml
# SPDX-FileCopyrightText: 2026 FoBE Studio
# SPDX-License-Identifier: Apache-2.0
tests:
  lib.meshcore.packet_manager.tdd:
    tags:
      - meshcore
      - packet_manager
      - ztest
    harness: ztest
    platform_allow:
      - qemu_x86
      - native_sim
    integration_platforms:
      - native_sim
```

## tests/zephyr/protocol/tables/testcase.yaml
```yaml
# SPDX-FileCopyrightText: 2026 FoBE Studio
# SPDX-License-Identifier: Apache-2.0
tests:
  lib.meshcore.tables.tdd:
    tags:
      - meshcore
      - tables
      - ztest
    harness: ztest
    platform_allow:
      - qemu_x86
      - native_sim
    integration_platforms:
      - native_sim
```

## tests/zephyr/runtime/oracle/testcase.yaml
```yaml
# SPDX-FileCopyrightText: 2026 FoBE Studio
# SPDX-License-Identifier: Apache-2.0
tests:
  lib.meshcore.oracle_parity:
    tags:
      - meshcore
      - oracle
      - parity
      - ztest
    harness: ztest
    platform_allow:
      - qemu_x86
      - native_sim
    integration_platforms:
      - native_sim
```
