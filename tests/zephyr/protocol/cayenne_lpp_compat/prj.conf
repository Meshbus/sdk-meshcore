## CMakeLists.txt
```
cmake_minimum_required(VERSION 3.20.0)

find_package(Zephyr REQUIRED HINTS $ENV{ZEPHYR_BASE})
project(meshcore_cayenne_lpp_compat_tdd_test)

include(${CMAKE_CURRENT_LIST_DIR}/../../common/meshcore_module.cmake)

zephyr_include_directories(
  ${MESHCORE_INTERNAL_INCLUDE_DIRS}
)

target_sources(app PRIVATE
  src/main.c
  ${MESHCORE_SUPPORT_CAYENNE_LPP_SOURCES}
)
```

## prj.conf
```kconfig
# SPDX-FileCopyrightText: 2026 FoBE Studio
# SPDX-License-Identifier: Apache-2.0
CONFIG_ZTEST=y
```

## src/main.c
```c
/* SPDX-License-Identifier: Apache-2.0 */
/* Copyright (c) 2026 FoBE Studio */

#include <errno.h>
#include <string.h>
#include <zephyr/ztest.h>

#include "meshcore_cayenne_lpp_compat.h"

#define BUFFER_CAP 64U
#define GPS_CHANNEL 7U
#define OTHER_CHANNEL 3U

struct scalar_vector {
	const char *name;
	int (*add)(struct cayenne_lpp_writer *writer, uint8_t channel, float value);
	float value;
	size_t size;
	uint8_t bytes[6];
};

struct gps_vector {
	const char *name;
	float latitude;
	float longitude;
	float altitude;
	uint8_t bytes[11];
};

struct location_vector {
	const char *name;
	size_t size;
	uint8_t bytes[BUFFER_CAP];
	bool present;
	int32_t latitude_e6;
	int32_t longitude_e6;
};

#include "vectors.h"

static void expect_buffer(const uint8_t *actual, const uint8_t *bytes, size_t size,
			  const char *name)
{
	uint8_t expected[BUFFER_CAP];

	zassert_true(size <= sizeof(expected), "%s invalid vector size", name);
	memset(expected, 0xa5, sizeof(expected));
	if (size != 0) {
		memcpy(expected, bytes, size);
	}
	/* Check both the encoded payload and untouched buffer tail. */
	zassert_mem_equal(expected, actual, sizeof(expected), "%s payload/tail mismatch", name);
}

ZTEST(meshcore_cayenne_lpp_compat_tdd, test_writer_encode_matches_vectors)
{
	struct cayenne_lpp_writer writer;
	uint8_t buffer[BUFFER_CAP];

	for (size_t i = 0; i < ARRAY_SIZE(scalar_vectors); ++i) {
		const struct scalar_vector *vector = &scalar_vectors[i];

		memset(buffer, 0xa5, sizeof(buffer));
		cayenne_lpp_init(&writer, buffer, sizeof(buffer));
		zassert_equal(0, vector->add(&writer, OTHER_CHANNEL, vector->value),
			      "%s encode failed", vector->name);
		zassert_equal(vector->size, cayenne_lpp_size(&writer),
			      "%s size mismatch", vector->name);
		expect_buffer(buffer, vector->bytes, vector->size, vector->name);

		memset(buffer, 0xa5, sizeof(buffer));
		cayenne_lpp_init(&writer, buffer, vector->size - 1U);
		zassert_equal(-ENOSPC, vector->add(&writer, OTHER_CHANNEL, vector->value),
			      "%s short buffer accepted", vector->name);
		zassert_equal(0, cayenne_lpp_size(&writer), "%s overflow advanced size",
			      vector->name);
		expect_buffer(buffer, NULL, 0, vector->name);
	}
	for (size_t i = 0; i < ARRAY_SIZE(gps_vectors); ++i) {
		const struct gps_vector *vector = &gps_vectors[i];

		memset(buffer, 0xa5, sizeof(buffer));
		cayenne_lpp_init(&writer, buffer, sizeof(buffer));
		zassert_equal(0, cayenne_lpp_add_gps(&writer, GPS_CHANNEL, vector->latitude,
						  vector->longitude, vector->altitude),
			      "%s encode failed", vector->name);
		zassert_equal(sizeof(vector->bytes), cayenne_lpp_size(&writer),
			      "%s size mismatch", vector->name);
		expect_buffer(buffer, vector->bytes, sizeof(vector->bytes), vector->name);

		memset(buffer, 0xa5, sizeof(buffer));
		cayenne_lpp_init(&writer, buffer, sizeof(vector->bytes) - 1U);
		zassert_equal(-ENOSPC,
			      cayenne_lpp_add_gps(&writer, GPS_CHANNEL, vector->latitude,
						 vector->longitude, vector->altitude),
			      "%s short buffer accepted", vector->name);
		zassert_equal(0, cayenne_lpp_size(&writer), "%s overflow advanced size",
			      vector->name);
		expect_buffer(buffer, NULL, 0, vector->name);
	}
}

ZTEST(meshcore_cayenne_lpp_compat_tdd, test_writer_size_overflow_and_invalid_args_match_expected)
{
	struct cayenne_lpp_writer writer;
	uint8_t buffer[BUFFER_CAP];

	memset(buffer, 0xa5, sizeof(buffer));
	cayenne_lpp_init(&writer, buffer, sizeof(combined_bytes));
	zassert_equal(0, cayenne_lpp_size(&writer), "initial size mismatch");
	zassert_equal(0, cayenne_lpp_size(NULL), "NULL size mismatch");
	zassert_equal(0, cayenne_lpp_add_voltage(&writer, OTHER_CHANNEL, 4.2f));
	zassert_equal(0, cayenne_lpp_add_gps(&writer, GPS_CHANNEL, 22.1f, 114.2f, 0.0f));
	zassert_equal(sizeof(combined_bytes), cayenne_lpp_size(&writer), "combined size mismatch");
	expect_buffer(buffer, combined_bytes, sizeof(combined_bytes), "combined fields");

	zassert_equal(-ENOSPC, cayenne_lpp_add_power(&writer, OTHER_CHANNEL, 11.0f));
	zassert_equal(sizeof(combined_bytes), cayenne_lpp_size(&writer), "overflow advanced size");
	expect_buffer(buffer, combined_bytes, sizeof(combined_bytes), "overflow");
	zassert_equal(-EINVAL, cayenne_lpp_add_voltage(NULL, OTHER_CHANNEL, 1.0f));
	writer.buf = NULL;
	zassert_equal(-EINVAL, cayenne_lpp_add_voltage(&writer, OTHER_CHANNEL, 1.0f));
}

ZTEST(meshcore_cayenne_lpp_compat_tdd, test_parse_location_matches_vectors)
{
	for (size_t i = 0; i < ARRAY_SIZE(location_vectors); ++i) {
		const struct location_vector *vector = &location_vectors[i];
		/* A failed parse must clear previous location data. */
		struct cayenne_lpp_location actual = { true, 1, true, 1 };

		cayenne_lpp_parse_location(vector->size ? vector->bytes : NULL,
					  vector->size, &actual);
		zassert_equal(vector->present, actual.has_latitude, "%s latitude flag",
			      vector->name);
		zassert_equal(vector->latitude_e6, actual.latitude_e6, "%s latitude", vector->name);
		zassert_equal(vector->present, actual.has_longitude, "%s longitude flag",
			      vector->name);
		zassert_equal(vector->longitude_e6, actual.longitude_e6, "%s longitude",
			      vector->name);
	}
}

ZTEST_SUITE(meshcore_cayenne_lpp_compat_tdd, NULL, NULL, NULL, NULL, NULL);
```

## src/vectors.h
```c
/* SPDX-License-Identifier: Apache-2.0 */
/* Copyright (c) 2026 FoBE Studio */
/* Generated by tools/capture_reference.cpp; see README.md. */

static const struct scalar_vector scalar_vectors[] = {
	{ "analog zero", cayenne_lpp_add_analog_input, 0.0f, 4U,
	  { 0x03, 0x02, 0x00, 0x00 } },
	{ "analog negative", cayenne_lpp_add_analog_input, -12.34f, 4U,
	  { 0x03, 0x02, 0xfb, 0x2e } },
	{ "barometric", cayenne_lpp_add_barometric_pressure, 1001.2f, 4U,
	  { 0x03, 0x73, 0x27, 0x1c } },
	{ "distance", cayenne_lpp_add_distance, 12.345f, 6U,
	  { 0x03, 0x82, 0x00, 0x00, 0x30, 0x39 } },
	{ "humidity", cayenne_lpp_add_relative_humidity, 55.5f, 3U,
	  { 0x03, 0x68, 0x6f } },
	{ "temperature negative", cayenne_lpp_add_temperature, -4.2f, 4U,
	  { 0x03, 0x67, 0xff, 0xd6 } },
	{ "voltage", cayenne_lpp_add_voltage, 4.19f, 4U,
	  { 0x03, 0x74, 0x01, 0xa3 } },
	{ "current", cayenne_lpp_add_current, 0.123f, 4U,
	  { 0x03, 0x75, 0x00, 0x7b } },
	{ "power", cayenne_lpp_add_power, 77.0f, 4U,
	  { 0x03, 0x80, 0x00, 0x4d } },
	{ "altitude negative", cayenne_lpp_add_altitude, -15.0f, 4U,
	  { 0x03, 0x79, 0xff, 0xf1 } },
};

static const struct gps_vector gps_vectors[] = {
	{ "gps positive", 22.5432f, 114.0579f, 12.34f,
	  { 0x07, 0x88, 0x03, 0x70, 0x98, 0x11, 0x67, 0x63,
		  0x00, 0x04, 0xd2 } },
	{ "gps negative", -22.5432f, -114.0579f, -1.23f,
	  { 0x07, 0x88, 0xfc, 0x8f, 0x68, 0xee, 0x98, 0x9d,
		  0xff, 0xff, 0x85 } },
};

static const uint8_t combined_bytes[] = { 0x03, 0x74, 0x01, 0xa3, 0x07, 0x88, 0x03, 0x5f,
		  0x48, 0x11, 0x6c, 0xf0, 0x00, 0x00, 0x00 };

static const struct location_vector location_vectors[] = {
	{ "empty payload", 0U,
	  { 0 },
	  false, 0, 0 },
	{ "non gps only", 8U,
	  { 0x03, 0x74, 0x01, 0xa3, 0x04, 0x67, 0x00, 0xe1 },
	  false, 0, 0 },
	{ "single gps", 11U,
	  { 0x07, 0x88, 0x03, 0x70, 0x98, 0x11, 0x67, 0x63,
		  0x00, 0x00, 0x00 },
	  true, 22543200, 114057900 },
	{ "gps with other fields", 19U,
	  { 0x03, 0x74, 0x01, 0xa3, 0x07, 0x88, 0x03, 0x6e,
		  0xe8, 0x11, 0x65, 0x22, 0x00, 0x00, 0x00, 0x04,
		  0x80, 0x00, 0x09 },
	  true, 22500000, 114000200 },
	{ "last gps wins", 26U,
	  { 0x07, 0x88, 0x00, 0x2b, 0x67, 0x00, 0x56, 0xce,
		  0x00, 0x00, 0x00, 0x03, 0x67, 0x00, 0xc8, 0x07,
		  0x88, 0xff, 0x7d, 0xcb, 0xff, 0x52, 0x64, 0x00,
		  0x00, 0x00 },
	  true, -3333300, -4444400 },
	{ "gps prefix before unknown", 11U,
	  { 0x07, 0x88, 0x01, 0xb2, 0x07, 0x03, 0x64, 0x0e,
		  0x00, 0x00, 0x00 },
	  true, 11111100, 22222200 },
	{ "unknown after gps", 14U,
	  { 0x07, 0x88, 0x01, 0xb2, 0x07, 0x03, 0x64, 0x0e,
		  0x00, 0x00, 0x00, 0x03, 0xee, 0xaa },
	  true, 11111100, 22222200 },
	{ "unknown before gps", 14U,
	  { 0x03, 0xee, 0x55, 0x07, 0x88, 0x01, 0xb2, 0x07,
		  0x03, 0x64, 0x0e, 0x00, 0x00, 0x00 },
	  false, 0, 0 },
	{ "truncated after gps", 14U,
	  { 0x07, 0x88, 0x01, 0xb2, 0x07, 0x03, 0x64, 0x0e,
		  0x00, 0x00, 0x00, 0x03, 0x67, 0x00 },
	  true, 11111100, 22222200 },
	{ "known skipped types before gps", 64U,
	  { 0x03, 0x64, 0x00, 0x00, 0x00, 0x01, 0x03, 0x76,
		  0x00, 0x00, 0x00, 0x01, 0x03, 0x78, 0x01, 0x03,
		  0x7d, 0x00, 0x01, 0x03, 0x83, 0x00, 0x00, 0x00,
		  0x01, 0x03, 0x84, 0x00, 0x01, 0x03, 0x85, 0x00,
		  0x00, 0x00, 0x01, 0x03, 0x87, 0x11, 0x22, 0x33,
		  0x03, 0x8e, 0x01, 0x03, 0xf0, 0x08, 0x01, 0x02,
		  0x03, 0x04, 0x05, 0x06, 0x07, 0x07, 0x88, 0x01,
		  0xe2, 0x40, 0x03, 0x94, 0x47, 0x00, 0x00, 0x00 },
	  true, 12345600, 23456700 },
	{ "malformed polyline before gps", 16U,
	  { 0x03, 0xf0, 0x08, 0x01, 0x02, 0x07, 0x88, 0x01,
		  0xe2, 0x40, 0x03, 0x94, 0x47, 0x00, 0x00, 0x00 },
	  false, 0, 0 },
};
```
